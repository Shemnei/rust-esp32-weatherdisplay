## crates/app/sdkconfig.defaults.esp32
```kconfig
# Place FreeRTOS functions into flash to save some IRAM on the ESP32
# Source: <https://github.com/espressif/esp-idf/blob/v5.2.1/examples/provisioning/wifi_prov_mgr/sdkconfig.defaults.esp32#L1C1-L2C45>
CONFIG_FREERTOS_PLACE_FUNCTIONS_INTO_FLASH=y
```

## sdkconfig.defaults
```kconfig
# Rust often needs a bit of an extra main task stack size compared to C (the default is 3K)
CONFIG_ESP_MAIN_TASK_STACK_SIZE=8000

# Override some defaults so BT stack is enabled
CONFIG_BT_ENABLED=y
CONFIG_BT_BLE_ENABLED=y
CONFIG_BTDM_CTRL_MODE_BLE_ONLY=y
CONFIG_BTDM_CTRL_MODE_BR_EDR_ONLY=n
CONFIG_BTDM_CTRL_MODE_BTDM=n
CONFIG_BT_NIMBLE_ENABLED=y
```
